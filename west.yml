## west.yml
```yaml
manifest:
  defaults:
    remote: sendrato-git

  remotes:
    - name: sendrato-git
      url-base: git@github.com:Sendrato

  projects:
    - name: zephyr
      path: zephyr
      west-commands: scripts/west-commands.yml
      revision: main-branch-develop
      import:
        name-whitelist:
          - ci-tools
          - cmsis
          - fatfs
          - hal_atmel
          - hal_nordic
          - hal_nxp
          - hal_st
          - hal_stm32
          - liblc3
          - libmetal
          - littlefs
          - mcuboot
          - mcumgr
          - mbedtls
          - nrf_hw_models
          - open-amp
          - openthread
          - segger
          - tinycbor
          - tinycrypt
          - zcbor
    - name: awareable-fw
      path: awareable-fw
      revision: develop
      import:
        name-whitelist:
          - ol23_sdk
    - name: sdk-nrf
      path: nrf
      # Using v2.5.2-sendrato as v2.7.0-sendrato triggers sysbuild when building for nRf5340
      # causing CMake configuration errors
      revision: v2.5.2-sendrato
      import:
        name-whitelist:
          - nrfxlib

  self:
    path: awf-zephyr
```
